/*
 * Copyright (c) 2017 Fuzhou Rockchip Electronics Co., Ltd
 *
 * This file is dual-licensed: you can use it either under the terms
 * of the GPL or the X11 license, at your option. Note that this dual
 * licensing only applies to this file, and not this project as a
 * whole.
 *
 *  a) This file is free software; you can redistribute it and/or
 *     modify it under the terms of the GNU General Public License as
 *     published by the Free Software Foundation; either version 2 of the
 *     License, or (at your option) any later version.
 *
 *     This file is distributed in the hope that it will be useful,
 *     but WITHOUT ANY WARRANTY; without even the implied warranty of
 *     MERCHANTABILITY or FITNESS FOR A PARTICULAR PURPOSE.  See the
 *     GNU General Public License for more details.
 *
 * Or, alternatively,
 *
 *  b) Permission is hereby granted, free of charge, to any person
 *     obtaining a copy of this software and associated documentation
 *     files (the "Software"), to deal in the Software without
 *     restriction, including without limitation the rights to use,
 *     copy, modify, merge, publish, distribute, sublicense, and/or
 *     sell copies of the Software, and to permit persons to whom the
 *     Software is furnished to do so, subject to the following
 *     conditions:
 *
 *     The above copyright notice and this permission notice shall be
 *     included in all copies or substantial portions of the Software.
 *
 *     THE SOFTWARE IS PROVIDED "AS IS", WITHOUT WARRANTY OF ANY KIND,
 *     EXPRESS OR IMPLIED, INCLUDING BUT NOT LIMITED TO THE WARRANTIES
 *     OF MERCHANTABILITY, FITNESS FOR A PARTICULAR PURPOSE AND
 *     NONINFRINGEMENT. IN NO EVENT SHALL THE AUTHORS OR COPYRIGHT
 *     HOLDERS BE LIABLE FOR ANY CLAIM, DAMAGES OR OTHER LIABILITY,
 *     WHETHER IN AN ACTION OF CONTRACT, TORT OR OTHERWISE, ARISING
 *     FROM, OUT OF OR IN CONNECTION WITH THE SOFTWARE OR THE USE OR
 *     OTHER DEALINGS IN THE SOFTWARE.
 */

#include <dt-bindings/rkmipi/mipi_dsi.h>

/ {
	
	rk-gz_gpio {
		compatible = "rk-gz-gpio";
		
		gpio_out_1 = <&gpio7 GPIO_A2 GPIO_ACTIVE_HIGH>;
		gpio_out_2 = <&gpio4 GPIO_D3 GPIO_ACTIVE_HIGH>;
		gpio_out_3 = <&gpio1 GPIO_D3 GPIO_ACTIVE_HIGH>;
		gpio_out_4 = <&gpio3 GPIO_C1 GPIO_ACTIVE_HIGH>;
		gpio_out_5 = <&gpio1 GPIO_D0 GPIO_ACTIVE_HIGH>;
		gpio_out_6 = <&gpio2 GPIO_A7 GPIO_ACTIVE_HIGH>;
		gpio_in_1 = <&gpio1 GPIO_D1 GPIO_ACTIVE_HIGH>;
		gpio_in_2 = <&gpio2 GPIO_B0 GPIO_ACTIVE_HIGH>;
		gpio_in_3 = <&gpio1 GPIO_D2 GPIO_ACTIVE_HIGH>;
		gpio_in_4 = <&gpio2 GPIO_B1 GPIO_ACTIVE_HIGH>;
		gpio_in_5 = <&gpio2 GPIO_B2 GPIO_ACTIVE_HIGH>;
	        status = "okay";
	};
	
		
	rk-gz_adc {
		status = "okay";
		compatible = "gz-adc0";
		io-channels=<&adc 0>;
	};
/*
	disp_mipi_init: mipi_dsi_init{
		compatible = "rockchip,mipi_dsi_init";
		rockchip,screen_init = <1>;
		rockchip,dsi_lane = <4>;
		rockchip,dsi_hs_clk = <1000>;
		rockchip,mipi_dsi_num = <1>;
	};


	disp_mipi_power_ctr: mipi_power_ctr {
		compatible = "rockchip,mipi_power_ctr";
							
		mipi_lcd_rst:mipi_lcd_rst{
				compatible = "rockchip,lcd_rst";
				rockchip,gpios = <&gpio7 13 GPIO_ACTIVE_HIGH>;
				rockchip,delay = <100>;
		};
										
		mipi_lcd_en:mipi_lcd_en {
				compatible = "rockchip,lcd_en";
				rockchip,gpios = <&gpio5 17 GPIO_ACTIVE_HIGH>;
				rockchip,delay = <100>;
		};

	};
	
	backlight: backlight {
		compatible = "pwm-backlight";
		brightness-levels = <
			  0   1   2   3   4   5   6   7
			  8   9  10  11  12  13  14  15
			 16  17  18  19  20  21  22  23
			 24  25  26  27  28  29  30  31
			 32  33  34  35  36  37  38  39
			 40  41  42  43  44  45  46  47
			 48  49  50  51  52  53  54  55
			 56  57  58  59  60  61  62  63
			 64  65  66  67  68  69  70  71
			 72  73  74  75  76  77  78  79
			 80  81  82  83  84  85  86  87
			 88  89  90  91  92  93  94  95
			 96  97  98  99 100 101 102 103
			104 105 106 107 108 109 110 111
			112 113 114 115 116 117 118 119
			120 121 122 123 124 125 126 127
			128 129 130 131 132 133 134 135
			136 137 138 139 140 141 142 143
			144 145 146 147 148 149 150 151
			152 153 154 155 156 157 158 159
			160 161 162 163 164 165 166 167
			168 169 170 171 172 173 174 175
			176 177 178 179 180 181 182 183
			184 185 186 187 188 189 190 191
			192 193 194 195 196 197 198 199
			200 201 202 203 204 205 206 207
			208 209 210 211 212 213 214 215
			216 217 218 219 220 221 222 223
			224 225 226 227 228 229 230 231
			232 233 234 235 236 237 238 239
			240 241 242 243 244 245 246 247
			248 249 250 251 252 253 254 255>;
		default-brightness-level = <128>;
		enable-gpios = <&gpio5 17  GPIO_ACTIVE_HIGH>;   //BL_EN 背光使能管
		pwms = <&pwm1 0 1000000 0>;
	};
	
	*/
/*	
	disp_timings: display-timings {
        native-mode = <&timing0>;
        compatible = "rockchip,display-timings";
        timing0: timing0 {
		screen-type = <SCREEN_DUAL_MIPI>;
		lvds-format = <LVDS_8BIT_2>;
		out-face    = <OUT_P888>;
		clock-frequency = <150000000>;
		hactive = <1200>;
		vactive = <1920>;
		hsync-len = <8>;
		hback-porch = <32>;
		hfront-porch = <156>;

		vsync-len = <2>;
		vback-porch = <6>;
		vfront-porch = <12>;

		hsync-active = <0>;
		vsync-active = <0>;
		de-active = <0>;
		pixelclk-active = <0>;
		swap-rb = <0>;
		swap-rg = <0>;
		swap-gb = <0>;
	};
};
*/
/*	
	disp_timings: display-timings {
		native-mode = <&timing0>;
		compatible = "rockchip,display-timings";
		timing0: timing0 {
				screen-type = <SCREEN_MIPI>;
				lvds-format = <LVDS_8BIT_2>;
				out-face = <OUT_P888>;
				clock-frequency = <145000000>;
				hactive = <720>;
				vactive = <1280>;
				hback-porch = <40>;
				hfront-porch = <40>;
				vback-porch = <16>;
				vfront-porch = <16>;
				hsync-len = <20>;
				vsync-len = <8>;
				hsync-active = <0>;
				vsync-active = <0>;
				de-active = <0>;
				pixelclk-active = <0>;
				swap-rb = <0>;
				swap-rg = <0>;
				swap-gb = <0>;
			}; 
	};*/
	


/*
	disp_mipi_init_cmds: screen-on-cmds {
		compatible = "rockchip,screen-on-cmds";
		rockchip,cmd_debug = <1>;
		rockchip,on-cmds1 { 
				compatible = "rockchip,on-cmds";
				rockchip,cmd_type = <LPDT>;     
				rockchip,dsi_id = <0>;         
				rockchip,cmd = <0x39 0xff 0x98 0x81 0x03>;    
				rockchip,cmd_delay = <0>;
		};	
		rockchip,on-cmds2 { 
				compatible = "rockchip,on-cmds";
				rockchip,cmd_type = <LPDT>;     
				rockchip,dsi_id = <0>;         
				rockchip,cmd = <0x15 0x01 0x00>;    
				rockchip,cmd_delay = <0>;
		};		
		rockchip,on-cmds3 { 
				compatible = "rockchip,on-cmds";
				rockchip,cmd_type = <LPDT>;     
				rockchip,dsi_id = <0>;         
				rockchip,cmd = <0x15 0x02 0x00>;    
				rockchip,cmd_delay = <0>;
		};		
		rockchip,on-cmds4 { 
				compatible = "rockchip,on-cmds";
				rockchip,cmd_type = <LPDT>;     
				rockchip,dsi_id = <0>;         
				rockchip,cmd = <0x15 0x03 0x72>;    
				rockchip,cmd_delay = <0>;
		};		
		rockchip,on-cmds5 { 
				compatible = "rockchip,on-cmds";
				rockchip,cmd_type = <LPDT>;     
				rockchip,dsi_id = <0>;         
				rockchip,cmd = <0x15 0x04 0x00>;    
				rockchip,cmd_delay = <0>;
		};	
		rockchip,on-cmds6 { 
				compatible = "rockchip,on-cmds";
				rockchip,cmd_type = <LPDT>;     
				rockchip,dsi_id = <0>;         
				rockchip,cmd = <0x15 0x05 0x00>;    
				rockchip,cmd_delay = <0>;
		};	
		rockchip,on-cmds7 { 
				compatible = "rockchip,on-cmds";
				rockchip,cmd_type = <LPDT>;     
				rockchip,dsi_id = <0>;         
				rockchip,cmd = <0x15 0x06 0x09>;    
				rockchip,cmd_delay = <0>;
		};		
		rockchip,on-cmds8 { 
				compatible = "rockchip,on-cmds";
				rockchip,cmd_type = <LPDT>;     
				rockchip,dsi_id = <0>;         
				rockchip,cmd = <0x15 0x07 0x00>;    
				rockchip,cmd_delay = <0>;
		};		
		rockchip,on-cmds9 { 
				compatible = "rockchip,on-cmds";
				rockchip,cmd_type = <LPDT>;     
				rockchip,dsi_id = <0>;         
				rockchip,cmd = <0x15 0x08 0x00>;    
				rockchip,cmd_delay = <0>;
		};		
		rockchip,on-cmds10 { 
				compatible = "rockchip,on-cmds";
				rockchip,cmd_type = <LPDT>;     
				rockchip,dsi_id = <0>;         
				rockchip,cmd = <0x15 0x09 0x01>;    
				rockchip,cmd_delay = <0>;
		};
		rockchip,on-cmds11 { 
				compatible = "rockchip,on-cmds";
				rockchip,cmd_type = <LPDT>;     
				rockchip,dsi_id = <0>;         
				rockchip,cmd = <0x15 0x0a 0x00>;    
				rockchip,cmd_delay = <0>;
		};	
		rockchip,on-cmds12 { 
				compatible = "rockchip,on-cmds";
				rockchip,cmd_type = <LPDT>;     
				rockchip,dsi_id = <0>;         
				rockchip,cmd = <0x15 0x0b 0x00>;    
				rockchip,cmd_delay = <0>;
		};		
		rockchip,on-cmds13 { 
				compatible = "rockchip,on-cmds";
				rockchip,cmd_type = <LPDT>;     
				rockchip,dsi_id = <0>;         
				rockchip,cmd = <0x15 0x0c 0x01>;    
				rockchip,cmd_delay = <0>;
		};		
		rockchip,on-cmds14 { 
				compatible = "rockchip,on-cmds";
				rockchip,cmd_type = <LPDT>;     
				rockchip,dsi_id = <0>;         
				rockchip,cmd = <0x15 0x0d 0x00>;    
				rockchip,cmd_delay = <0>;
		};		
		rockchip,on-cmds15 { 
				compatible = "rockchip,on-cmds";
				rockchip,cmd_type = <LPDT>;     
				rockchip,dsi_id = <0>;         
				rockchip,cmd = <0x15 0x0e 0x00>;    
				rockchip,cmd_delay = <0>;
		};	
		rockchip,on-cmds16 { 
				compatible = "rockchip,on-cmds";
				rockchip,cmd_type = <LPDT>;     
				rockchip,dsi_id = <0>;         
				rockchip,cmd = <0x15 0x0f 0x00>;    
				rockchip,cmd_delay = <0>;
		};	
		rockchip,on-cmds17 { 
				compatible = "rockchip,on-cmds";
				rockchip,cmd_type = <LPDT>;     
				rockchip,dsi_id = <0>;         
				rockchip,cmd = <0x15 0x10 0x00>;    
				rockchip,cmd_delay = <0>;
		};		
		rockchip,on-cmds18 { 
				compatible = "rockchip,on-cmds";
				rockchip,cmd_type = <LPDT>;     
				rockchip,dsi_id = <0>;         
				rockchip,cmd = <0x15 0x11 0x00>;    
				rockchip,cmd_delay = <0>;
		};		
		rockchip,on-cmds19 { 
				compatible = "rockchip,on-cmds";
				rockchip,cmd_type = <LPDT>;     
				rockchip,dsi_id = <0>;         
				rockchip,cmd = <0x15 0x12 0x00>;    
				rockchip,cmd_delay = <0>;
		};		
		rockchip,on-cmds20 { 
				compatible = "rockchip,on-cmds";
				rockchip,cmd_type = <LPDT>;     
				rockchip,dsi_id = <0>;         
				rockchip,cmd = <0x15 0x13 0x00>;    
				rockchip,cmd_delay = <0>;
		};	
		rockchip,on-cmds21 { 
				compatible = "rockchip,on-cmds";
				rockchip,cmd_type = <LPDT>;     
				rockchip,dsi_id = <0>;         
				rockchip,cmd = <0x15 0x14 0x00>;    
				rockchip,cmd_delay = <0>;
		};	
		rockchip,on-cmds22 { 
				compatible = "rockchip,on-cmds";
				rockchip,cmd_type = <LPDT>;     
				rockchip,dsi_id = <0>;         
				rockchip,cmd = <0x15 0x15 0x00>;    
				rockchip,cmd_delay = <0>;
		};		
		rockchip,on-cmds23 { 
				compatible = "rockchip,on-cmds";
				rockchip,cmd_type = <LPDT>;     
				rockchip,dsi_id = <0>;         
				rockchip,cmd = <0x15 0x16 0x00>;    
				rockchip,cmd_delay = <0>;
		};		
		rockchip,on-cmds24 { 
				compatible = "rockchip,on-cmds";
				rockchip,cmd_type = <LPDT>;     
				rockchip,dsi_id = <0>;         
				rockchip,cmd = <0x15 0x17 0x00>;    
				rockchip,cmd_delay = <0>;
		};		
		rockchip,on-cmds25 { 
				compatible = "rockchip,on-cmds";
				rockchip,cmd_type = <LPDT>;     
				rockchip,dsi_id = <0>;         
				rockchip,cmd = <0x15 0x18 0x00>;    
				rockchip,cmd_delay = <0>;
		};	
		rockchip,on-cmds26 { 
				compatible = "rockchip,on-cmds";
				rockchip,cmd_type = <LPDT>;     
				rockchip,dsi_id = <0>;         
				rockchip,cmd = <0x15 0x19 0x00>;    
				rockchip,cmd_delay = <0>;
		};	
		rockchip,on-cmds27 { 
				compatible = "rockchip,on-cmds";
				rockchip,cmd_type = <LPDT>;     
				rockchip,dsi_id = <0>;         
				rockchip,cmd = <0x15 0x1a 0x00>;    
				rockchip,cmd_delay = <0>;
		};		
		rockchip,on-cmds28 { 
				compatible = "rockchip,on-cmds";
				rockchip,cmd_type = <LPDT>;     
				rockchip,dsi_id = <0>;         
				rockchip,cmd = <0x15 0x1b 0x00>;    
				rockchip,cmd_delay = <0>;
		};		
		rockchip,on-cmds29 { 
				compatible = "rockchip,on-cmds";
				rockchip,cmd_type = <LPDT>;     
				rockchip,dsi_id = <0>;         
				rockchip,cmd = <0x15 0x1c 0x00>;    
				rockchip,cmd_delay = <0>;
		};		
		rockchip,on-cmds30 { 
				compatible = "rockchip,on-cmds";
				rockchip,cmd_type = <LPDT>;     
				rockchip,dsi_id = <0>;         
				rockchip,cmd = <0x15 0x1d 0x00>;    
				rockchip,cmd_delay = <0>;
		};	
		rockchip,on-cmds31 { 
				compatible = "rockchip,on-cmds";
				rockchip,cmd_type = <LPDT>;     
				rockchip,dsi_id = <0>;         
				rockchip,cmd = <0x15 0x1e 0x40>;    
				rockchip,cmd_delay = <0>;
		};	
		rockchip,on-cmds32 { 
				compatible = "rockchip,on-cmds";
				rockchip,cmd_type = <LPDT>;     
				rockchip,dsi_id = <0>;         
				rockchip,cmd = <0x15 0x1f 0x80>;    
				rockchip,cmd_delay = <0>;
		};		
		rockchip,on-cmds33 { 
				compatible = "rockchip,on-cmds";
				rockchip,cmd_type = <LPDT>;     
				rockchip,dsi_id = <0>;         
				rockchip,cmd = <0x15 0x20 0x05>;    
				rockchip,cmd_delay = <0>;
		};		
		rockchip,on-cmds34 { 
				compatible = "rockchip,on-cmds";
				rockchip,cmd_type = <LPDT>;     
				rockchip,dsi_id = <0>;         
				rockchip,cmd = <0x15 0x21 0x02>;    
				rockchip,cmd_delay = <0>;
		};		
		rockchip,on-cmds35 { 
				compatible = "rockchip,on-cmds";
				rockchip,cmd_type = <LPDT>;     
				rockchip,dsi_id = <0>;         
				rockchip,cmd = <0x15 0x22 0x00>;    
				rockchip,cmd_delay = <0>;
		};	
		rockchip,on-cmds36 { 
				compatible = "rockchip,on-cmds";
				rockchip,cmd_type = <LPDT>;     
				rockchip,dsi_id = <0>;         
				rockchip,cmd = <0x15 0x23 0x00>;    
				rockchip,cmd_delay = <0>;
		};	
		rockchip,on-cmds37 { 
				compatible = "rockchip,on-cmds";
				rockchip,cmd_type = <LPDT>;     
				rockchip,dsi_id = <0>;         
				rockchip,cmd = <0x15 0x24 0x00>;    
				rockchip,cmd_delay = <0>;
		};		
		rockchip,on-cmds38 { 
				compatible = "rockchip,on-cmds";
				rockchip,cmd_type = <LPDT>;     
				rockchip,dsi_id = <0>;         
				rockchip,cmd = <0x15 0x25 0x00>;    
				rockchip,cmd_delay = <0>;
		};		
		rockchip,on-cmds39 { 
				compatible = "rockchip,on-cmds";
				rockchip,cmd_type = <LPDT>;     
				rockchip,dsi_id = <0>;         
				rockchip,cmd = <0x15 0x26 0x00>;    
				rockchip,cmd_delay = <0>;
		};		
		rockchip,on-cmds40 { 
				compatible = "rockchip,on-cmds";
				rockchip,cmd_type = <LPDT>;     
				rockchip,dsi_id = <0>;         
				rockchip,cmd = <0x15 0x27 0x00>;    
				rockchip,cmd_delay = <0>;
		};	
		rockchip,on-cmds41 { 
				compatible = "rockchip,on-cmds";
				rockchip,cmd_type = <LPDT>;     
				rockchip,dsi_id = <0>;         
				rockchip,cmd = <0x15 0x28 0x33>;    
				rockchip,cmd_delay = <0>;
		};	
		rockchip,on-cmds42 { 
				compatible = "rockchip,on-cmds";
				rockchip,cmd_type = <LPDT>;     
				rockchip,dsi_id = <0>;         
				rockchip,cmd = <0x15 0x29 0x02>;    
				rockchip,cmd_delay = <0>;
		};		
		rockchip,on-cmds43 { 
				compatible = "rockchip,on-cmds";
				rockchip,cmd_type = <LPDT>;     
				rockchip,dsi_id = <0>;         
				rockchip,cmd = <0x15 0x2a 0x00>;    
				rockchip,cmd_delay = <0>;
		};		
		rockchip,on-cmds44 { 
				compatible = "rockchip,on-cmds";
				rockchip,cmd_type = <LPDT>;     
				rockchip,dsi_id = <0>;         
				rockchip,cmd = <0x15 0x2b 0x00>;    
				rockchip,cmd_delay = <0>;
		};		
		rockchip,on-cmds45 { 
				compatible = "rockchip,on-cmds";
				rockchip,cmd_type = <LPDT>;     
				rockchip,dsi_id = <0>;         
				rockchip,cmd = <0x15 0x2c 0x00>;    
				rockchip,cmd_delay = <0>;
		};	
		rockchip,on-cmds46 { 
				compatible = "rockchip,on-cmds";
				rockchip,cmd_type = <LPDT>;     
				rockchip,dsi_id = <0>;         
				rockchip,cmd = <0x15 0x2d 0x00>;    
				rockchip,cmd_delay = <0>;
		};	
		rockchip,on-cmds47 { 
				compatible = "rockchip,on-cmds";
				rockchip,cmd_type = <LPDT>;     
				rockchip,dsi_id = <0>;         
				rockchip,cmd = <0x15 0x2e 0x00>;    
				rockchip,cmd_delay = <0>;
		};		
		rockchip,on-cmds48 { 
				compatible = "rockchip,on-cmds";
				rockchip,cmd_type = <LPDT>;     
				rockchip,dsi_id = <0>;         
				rockchip,cmd = <0x15 0x2f 0x00>;    
				rockchip,cmd_delay = <0>;
		};		
		rockchip,on-cmds49 { 
				compatible = "rockchip,on-cmds";
				rockchip,cmd_type = <LPDT>;     
				rockchip,dsi_id = <0>;         
				rockchip,cmd = <0x15 0x30 0x00>;    
				rockchip,cmd_delay = <0>;
		};		
		rockchip,on-cmds50 { 
				compatible = "rockchip,on-cmds";
				rockchip,cmd_type = <LPDT>;     
				rockchip,dsi_id = <0>;         
				rockchip,cmd = <0x15 0x31 0x00>;    
				rockchip,cmd_delay = <0>;
		};	
		rockchip,on-cmds51 { 
				compatible = "rockchip,on-cmds";
				rockchip,cmd_type = <LPDT>;     
				rockchip,dsi_id = <0>;         
				rockchip,cmd = <0x15 0x32 0x00>;    
				rockchip,cmd_delay = <0>;
		};	
		rockchip,on-cmds52 { 
				compatible = "rockchip,on-cmds";
				rockchip,cmd_type = <LPDT>;     
				rockchip,dsi_id = <0>;         
				rockchip,cmd = <0x15 0x32 0x00>;    
				rockchip,cmd_delay = <0>;
		};		
		rockchip,on-cmds53 { 
				compatible = "rockchip,on-cmds";
				rockchip,cmd_type = <LPDT>;     
				rockchip,dsi_id = <0>;         
				rockchip,cmd = <0x15 0x33 0x00>;    
				rockchip,cmd_delay = <0>;
		};		
		rockchip,on-cmds54 { 
				compatible = "rockchip,on-cmds";
				rockchip,cmd_type = <LPDT>;     
				rockchip,dsi_id = <0>;         
				rockchip,cmd = <0x15 0x34 0x04>;    
				rockchip,cmd_delay = <0>;
		};		
		rockchip,on-cmds55 { 
				compatible = "rockchip,on-cmds";
				rockchip,cmd_type = <LPDT>;     
				rockchip,dsi_id = <0>;         
				rockchip,cmd = <0x15 0x35 0x00>;    
				rockchip,cmd_delay = <0>;
		};	
		rockchip,on-cmds56 { 
				compatible = "rockchip,on-cmds";
				rockchip,cmd_type = <LPDT>;     
				rockchip,dsi_id = <0>;         
				rockchip,cmd = <0x15 0x36 0x00>;    
				rockchip,cmd_delay = <0>;
		};	
		rockchip,on-cmds57 { 
				compatible = "rockchip,on-cmds";
				rockchip,cmd_type = <LPDT>;     
				rockchip,dsi_id = <0>;         
				rockchip,cmd = <0x15 0x37 0x00>;    
				rockchip,cmd_delay = <0>;
		};		
		rockchip,on-cmds58 { 
				compatible = "rockchip,on-cmds";
				rockchip,cmd_type = <LPDT>;     
				rockchip,dsi_id = <0>;         
				rockchip,cmd = <0x15 0x38 0x3c>;    
				rockchip,cmd_delay = <0>;
		};		
		rockchip,on-cmds59 { 
				compatible = "rockchip,on-cmds";
				rockchip,cmd_type = <LPDT>;     
				rockchip,dsi_id = <0>;         
				rockchip,cmd = <0x15 0x39 0x00>;    
				rockchip,cmd_delay = <0>;
		};		
		rockchip,on-cmds60 { 
				compatible = "rockchip,on-cmds";
				rockchip,cmd_type = <LPDT>;     
				rockchip,dsi_id = <0>;         
				rockchip,cmd = <0x15 0x3a 0x40>;    
				rockchip,cmd_delay = <0>;
		};
		rockchip,on-cmds61 { 
				compatible = "rockchip,on-cmds";
				rockchip,cmd_type = <LPDT>;     
				rockchip,dsi_id = <0>;         
				rockchip,cmd = <0x15 0x3b 0x40>;    
				rockchip,cmd_delay = <0>;
		};	
		rockchip,on-cmds62 { 
				compatible = "rockchip,on-cmds";
				rockchip,cmd_type = <LPDT>;     
				rockchip,dsi_id = <0>;         
				rockchip,cmd = <0x15 0x3c 0x00>;    
				rockchip,cmd_delay = <0>;
		};		
		rockchip,on-cmds63 { 
				compatible = "rockchip,on-cmds";
				rockchip,cmd_type = <LPDT>;     
				rockchip,dsi_id = <0>;         
				rockchip,cmd = <0x15 0x3d 0x00>;    
				rockchip,cmd_delay = <0>;
		};		
		rockchip,on-cmds64 { 
				compatible = "rockchip,on-cmds";
				rockchip,cmd_type = <LPDT>;     
				rockchip,dsi_id = <0>;         
				rockchip,cmd = <0x15 0x3e 0x00>;    
				rockchip,cmd_delay = <0>;
		};		
		rockchip,on-cmds65 { 
				compatible = "rockchip,on-cmds";
				rockchip,cmd_type = <LPDT>;     
				rockchip,dsi_id = <0>;         
				rockchip,cmd = <0x15 0x3f 0x00>;    
				rockchip,cmd_delay = <0>;
		};	
		rockchip,on-cmds66 { 
				compatible = "rockchip,on-cmds";
				rockchip,cmd_type = <LPDT>;     
				rockchip,dsi_id = <0>;         
				rockchip,cmd = <0x15 0x40 0x00>;    
				rockchip,cmd_delay = <0>;
		};	
		rockchip,on-cmds67 { 
				compatible = "rockchip,on-cmds";
				rockchip,cmd_type = <LPDT>;     
				rockchip,dsi_id = <0>;         
				rockchip,cmd = <0x15 0x41 0x00>;    
				rockchip,cmd_delay = <0>;
		};		
		rockchip,on-cmds68 { 
				compatible = "rockchip,on-cmds";
				rockchip,cmd_type = <LPDT>;     
				rockchip,dsi_id = <0>;         
				rockchip,cmd = <0x15 0x42 0x00>;    
				rockchip,cmd_delay = <0>;
		};		
		rockchip,on-cmds69 { 
				compatible = "rockchip,on-cmds";
				rockchip,cmd_type = <LPDT>;     
				rockchip,dsi_id = <0>;         
				rockchip,cmd = <0x15 0x43 0x00>;    
				rockchip,cmd_delay = <0>;
		};		
		rockchip,on-cmds70 { 
				compatible = "rockchip,on-cmds";
				rockchip,cmd_type = <LPDT>;     
				rockchip,dsi_id = <0>;         
				rockchip,cmd = <0x15 0x44 0x00>;    
				rockchip,cmd_delay = <0>;
		};	
		rockchip,on-cmds71 { 
				compatible = "rockchip,on-cmds";
				rockchip,cmd_type = <LPDT>;     
				rockchip,dsi_id = <0>;         
				rockchip,cmd = <0x15 0x50 0x01>;    
				rockchip,cmd_delay = <0>;
		};	
		rockchip,on-cmds72 { 
				compatible = "rockchip,on-cmds";
				rockchip,cmd_type = <LPDT>;     
				rockchip,dsi_id = <0>;         
				rockchip,cmd = <0x15 0x51 0x23>;    
				rockchip,cmd_delay = <0>;
		};		
		rockchip,on-cmds73 { 
				compatible = "rockchip,on-cmds";
				rockchip,cmd_type = <LPDT>;     
				rockchip,dsi_id = <0>;         
				rockchip,cmd = <0x15 0x52 0x45>;    
				rockchip,cmd_delay = <0>;
		};		
		rockchip,on-cmds74 { 
				compatible = "rockchip,on-cmds";
				rockchip,cmd_type = <LPDT>;     
				rockchip,dsi_id = <0>;         
				rockchip,cmd = <0x15 0x53 0x67>;    
				rockchip,cmd_delay = <0>;
		};		
		rockchip,on-cmds75 { 
				compatible = "rockchip,on-cmds";
				rockchip,cmd_type = <LPDT>;     
				rockchip,dsi_id = <0>;         
				rockchip,cmd = <0x15 0x54 0x89>;    
				rockchip,cmd_delay = <0>;
		};	
		rockchip,on-cmds76 { 
				compatible = "rockchip,on-cmds";
				rockchip,cmd_type = <LPDT>;     
				rockchip,dsi_id = <0>;         
				rockchip,cmd = <0x15 0x55 0xab>;    
				rockchip,cmd_delay = <0>;
		};	
		rockchip,on-cmds77 { 
				compatible = "rockchip,on-cmds";
				rockchip,cmd_type = <LPDT>;     
				rockchip,dsi_id = <0>;         
				rockchip,cmd = <0x15 0x56 0x01>;    
				rockchip,cmd_delay = <0>;
		};		
		rockchip,on-cmds78 { 
				compatible = "rockchip,on-cmds";
				rockchip,cmd_type = <LPDT>;     
				rockchip,dsi_id = <0>;         
				rockchip,cmd = <0x15 0x57 0x23>;    
				rockchip,cmd_delay = <0>;
		};		
		rockchip,on-cmds79 { 
				compatible = "rockchip,on-cmds";
				rockchip,cmd_type = <LPDT>;     
				rockchip,dsi_id = <0>;         
				rockchip,cmd = <0x15 0x58 0x45>;    
				rockchip,cmd_delay = <0>;
		};		
		rockchip,on-cmds80 { 
				compatible = "rockchip,on-cmds";
				rockchip,cmd_type = <LPDT>;     
				rockchip,dsi_id = <0>;         
				rockchip,cmd = <0x15 0x59 0x67>;    
				rockchip,cmd_delay = <0>;
		};
		rockchip,on-cmds81 { 
				compatible = "rockchip,on-cmds";
				rockchip,cmd_type = <LPDT>;     
				rockchip,dsi_id = <0>;         
				rockchip,cmd = <0x15 0x5a 0x89>;    
				rockchip,cmd_delay = <0>;
		};	
		rockchip,on-cmds82 { 
				compatible = "rockchip,on-cmds";
				rockchip,cmd_type = <LPDT>;     
				rockchip,dsi_id = <0>;         
				rockchip,cmd = <0x15 0x5b 0xab>;    
				rockchip,cmd_delay = <0>;
		};		
		rockchip,on-cmds83 { 
				compatible = "rockchip,on-cmds";
				rockchip,cmd_type = <LPDT>;     
				rockchip,dsi_id = <0>;         
				rockchip,cmd = <0x15 0x5c 0xcd>;    
				rockchip,cmd_delay = <0>;
		};		
		rockchip,on-cmds84 { 
				compatible = "rockchip,on-cmds";
				rockchip,cmd_type = <LPDT>;     
				rockchip,dsi_id = <0>;         
				rockchip,cmd = <0x15 0x5d 0xef>;    
				rockchip,cmd_delay = <0>;
		};		
		rockchip,on-cmds85 { 
				compatible = "rockchip,on-cmds";
				rockchip,cmd_type = <LPDT>;     
				rockchip,dsi_id = <0>;         
				rockchip,cmd = <0x15 0x5e 0x11>;    
				rockchip,cmd_delay = <0>;
		};	
		rockchip,on-cmds86 { 
				compatible = "rockchip,on-cmds";
				rockchip,cmd_type = <LPDT>;     
				rockchip,dsi_id = <0>;         
				rockchip,cmd = <0x15 0x5f 0x01>;    
				rockchip,cmd_delay = <0>;
		};	
		rockchip,on-cmds87 { 
				compatible = "rockchip,on-cmds";
				rockchip,cmd_type = <LPDT>;     
				rockchip,dsi_id = <0>;         
				rockchip,cmd = <0x15 0x60 0x00>;    
				rockchip,cmd_delay = <0>;
		};		
		rockchip,on-cmds88 { 
				compatible = "rockchip,on-cmds";
				rockchip,cmd_type = <LPDT>;     
				rockchip,dsi_id = <0>;         
				rockchip,cmd = <0x15 0x61 0x15>;    
				rockchip,cmd_delay = <0>;
		};		
		rockchip,on-cmds89 { 
				compatible = "rockchip,on-cmds";
				rockchip,cmd_type = <LPDT>;     
				rockchip,dsi_id = <0>;         
				rockchip,cmd = <0x15 0x62 0x14>;    
				rockchip,cmd_delay = <0>;
		};		
		rockchip,on-cmds90 { 
				compatible = "rockchip,on-cmds";
				rockchip,cmd_type = <LPDT>;     
				rockchip,dsi_id = <0>;         
				rockchip,cmd = <0x15 0x63 0x0e>;    
				rockchip,cmd_delay = <0>;
		};
		rockchip,on-cmds91 { 
				compatible = "rockchip,on-cmds";
				rockchip,cmd_type = <LPDT>;     
				rockchip,dsi_id = <0>;         
				rockchip,cmd = <0x15 0x64 0x0f>;    
				rockchip,cmd_delay = <0>;
		};	
		rockchip,on-cmds92 { 
				compatible = "rockchip,on-cmds";
				rockchip,cmd_type = <LPDT>;     
				rockchip,dsi_id = <0>;         
				rockchip,cmd = <0x15 0x65 0x0c>;    
				rockchip,cmd_delay = <0>;
		};		
		rockchip,on-cmds93 { 
				compatible = "rockchip,on-cmds";
				rockchip,cmd_type = <LPDT>;     
				rockchip,dsi_id = <0>;         
				rockchip,cmd = <0x15 0x66 0x0d>;    
				rockchip,cmd_delay = <0>;
		};		
		rockchip,on-cmds94 { 
				compatible = "rockchip,on-cmds";
				rockchip,cmd_type = <LPDT>;     
				rockchip,dsi_id = <0>;         
				rockchip,cmd = <0x15 0x67 0x06>;    
				rockchip,cmd_delay = <0>;
		};		
		rockchip,on-cmds95 { 
				compatible = "rockchip,on-cmds";
				rockchip,cmd_type = <LPDT>;     
				rockchip,dsi_id = <0>;         
				rockchip,cmd = <0x15 0x68 0x02>;    
				rockchip,cmd_delay = <0>;
		};	
		rockchip,on-cmds96 { 
				compatible = "rockchip,on-cmds";
				rockchip,cmd_type = <LPDT>;     
				rockchip,dsi_id = <0>;         
				rockchip,cmd = <0x15 0x69 0x07>;    
				rockchip,cmd_delay = <0>;
		};	
		rockchip,on-cmds97 { 
				compatible = "rockchip,on-cmds";
				rockchip,cmd_type = <LPDT>;     
				rockchip,dsi_id = <0>;         
				rockchip,cmd = <0x15 0x6a 0x02>;    
				rockchip,cmd_delay = <0>;
		};		
		rockchip,on-cmds98 { 
				compatible = "rockchip,on-cmds";
				rockchip,cmd_type = <LPDT>;     
				rockchip,dsi_id = <0>;         
				rockchip,cmd = <0x15 0x6b 0x02>;    
				rockchip,cmd_delay = <0>;
		};		
		rockchip,on-cmds99 { 
				compatible = "rockchip,on-cmds";
				rockchip,cmd_type = <LPDT>;     
				rockchip,dsi_id = <0>;         
				rockchip,cmd = <0x15 0x6c 0x02>;    
				rockchip,cmd_delay = <0>;
		};		
		rockchip,on-cmds100 { 
				compatible = "rockchip,on-cmds";
				rockchip,cmd_type = <LPDT>;     
				rockchip,dsi_id = <0>;         
				rockchip,cmd = <0x15 0x6d 0x02>;    
				rockchip,cmd_delay = <0>;
		};
		rockchip,on-cmds101 { 
				compatible = "rockchip,on-cmds";
				rockchip,cmd_type = <LPDT>;     
				rockchip,dsi_id = <0>;         
				rockchip,cmd = <0x15 0x6e 0x02>;    
				rockchip,cmd_delay = <0>;
		};	
		rockchip,on-cmds102 { 
				compatible = "rockchip,on-cmds";
				rockchip,cmd_type = <LPDT>;     
				rockchip,dsi_id = <0>;         
				rockchip,cmd = <0x15 0x6f 0x02>;    
				rockchip,cmd_delay = <0>;
		};		
		rockchip,on-cmds103 { 
				compatible = "rockchip,on-cmds";
				rockchip,cmd_type = <LPDT>;     
				rockchip,dsi_id = <0>;         
				rockchip,cmd = <0x15 0x70 0x02>;    
				rockchip,cmd_delay = <0>;
		};		
		rockchip,on-cmds104 { 
				compatible = "rockchip,on-cmds";
				rockchip,cmd_type = <LPDT>;     
				rockchip,dsi_id = <0>;         
				rockchip,cmd = <0x15 0x71 0x02>;    
				rockchip,cmd_delay = <0>;
		};		
		rockchip,on-cmds105 { 
				compatible = "rockchip,on-cmds";
				rockchip,cmd_type = <LPDT>;     
				rockchip,dsi_id = <0>;         
				rockchip,cmd = <0x15 0x72 0x02>;    
				rockchip,cmd_delay = <0>;
		};	
		rockchip,on-cmds106 { 
				compatible = "rockchip,on-cmds";
				rockchip,cmd_type = <LPDT>;     
				rockchip,dsi_id = <0>;         
				rockchip,cmd = <0x15 0x73 0x02>;    
				rockchip,cmd_delay = <0>;
		};	
		rockchip,on-cmds107 { 
				compatible = "rockchip,on-cmds";
				rockchip,cmd_type = <LPDT>;     
				rockchip,dsi_id = <0>;         
				rockchip,cmd = <0x15 0x74 0x02>;    
				rockchip,cmd_delay = <0>;
		};		
		rockchip,on-cmds108 { 
				compatible = "rockchip,on-cmds";
				rockchip,cmd_type = <LPDT>;     
				rockchip,dsi_id = <0>;         
				rockchip,cmd = <0x15 0x75 0x01>;    
				rockchip,cmd_delay = <0>;
		};		
		rockchip,on-cmds109 { 
				compatible = "rockchip,on-cmds";
				rockchip,cmd_type = <LPDT>;     
				rockchip,dsi_id = <0>;         
				rockchip,cmd = <0x15 0x76 0x00>;    
				rockchip,cmd_delay = <0>;
		};	
		rockchip,on-cmds110 { 
				compatible = "rockchip,on-cmds";
				rockchip,cmd_type = <LPDT>;     
				rockchip,dsi_id = <0>;         
				rockchip,cmd = <0x15 0x77 0x14>;    
				rockchip,cmd_delay = <0>;
		};
		rockchip,on-cmds111 { 
				compatible = "rockchip,on-cmds";
				rockchip,cmd_type = <LPDT>;     
				rockchip,dsi_id = <0>;         
				rockchip,cmd = <0x15 0x78 0x15>;    
				rockchip,cmd_delay = <0>;
		};	
		rockchip,on-cmds112 { 
				compatible = "rockchip,on-cmds";
				rockchip,cmd_type = <LPDT>;     
				rockchip,dsi_id = <0>;         
				rockchip,cmd = <0x15 0x79 0x0e>;    
				rockchip,cmd_delay = <0>;
		};		
		rockchip,on-cmds113 { 
				compatible = "rockchip,on-cmds";
				rockchip,cmd_type = <LPDT>;     
				rockchip,dsi_id = <0>;         
				rockchip,cmd = <0x15 0x7a 0x0f>;    
				rockchip,cmd_delay = <0>;
		};		
		rockchip,on-cmds114 { 
				compatible = "rockchip,on-cmds";
				rockchip,cmd_type = <LPDT>;     
				rockchip,dsi_id = <0>;         
				rockchip,cmd = <0x15 0x7b 0x0c>;    
				rockchip,cmd_delay = <0>;
		};		
		rockchip,on-cmds115 { 
				compatible = "rockchip,on-cmds";
				rockchip,cmd_type = <LPDT>;     
				rockchip,dsi_id = <0>;         
				rockchip,cmd = <0x15 0x7c 0x0d>;    
				rockchip,cmd_delay = <0>;
		};	
		rockchip,on-cmds116 { 
				compatible = "rockchip,on-cmds";
				rockchip,cmd_type = <LPDT>;     
				rockchip,dsi_id = <0>;         
				rockchip,cmd = <0x15 0x7d 0x06>;    
				rockchip,cmd_delay = <0>;
		};	
		rockchip,on-cmds117 { 
				compatible = "rockchip,on-cmds";
				rockchip,cmd_type = <LPDT>;     
				rockchip,dsi_id = <0>;         
				rockchip,cmd = <0x15 0x7e 0x02>;    
				rockchip,cmd_delay = <0>;
		};		
		rockchip,on-cmds118 { 
				compatible = "rockchip,on-cmds";
				rockchip,cmd_type = <LPDT>;     
				rockchip,dsi_id = <0>;         
				rockchip,cmd = <0x15 0x7f 0x07>;    
				rockchip,cmd_delay = <0>;
		};		
		rockchip,on-cmds119 { 
				compatible = "rockchip,on-cmds";
				rockchip,cmd_type = <LPDT>;     
				rockchip,dsi_id = <0>;         
				rockchip,cmd = <0x15 0x80 0x02>;    
				rockchip,cmd_delay = <0>;
		};	
		rockchip,on-cmds120 { 
				compatible = "rockchip,on-cmds";
				rockchip,cmd_type = <LPDT>;     
				rockchip,dsi_id = <0>;         
				rockchip,cmd = <0x15 0x81 0x02>;    
				rockchip,cmd_delay = <0>;
		};
		rockchip,on-cmds121 { 
				compatible = "rockchip,on-cmds";
				rockchip,cmd_type = <LPDT>;     
				rockchip,dsi_id = <0>;         
				rockchip,cmd = <0x15 0x83 0x02>;    
				rockchip,cmd_delay = <0>;
		};	
		rockchip,on-cmds122 { 
				compatible = "rockchip,on-cmds";
				rockchip,cmd_type = <LPDT>;     
				rockchip,dsi_id = <0>;         
				rockchip,cmd = <0x15 0x84 0x02>;    
				rockchip,cmd_delay = <0>;
		};		
		rockchip,on-cmds123 { 
				compatible = "rockchip,on-cmds";
				rockchip,cmd_type = <LPDT>;     
				rockchip,dsi_id = <0>;         
				rockchip,cmd = <0x15 0x85 0x02>;    
				rockchip,cmd_delay = <0>;
		};		
		rockchip,on-cmds124 { 
				compatible = "rockchip,on-cmds";
				rockchip,cmd_type = <LPDT>;     
				rockchip,dsi_id = <0>;         
				rockchip,cmd = <0x15 0x86 0x02>;    
				rockchip,cmd_delay = <0>;
		};		
		rockchip,on-cmds125 { 
				compatible = "rockchip,on-cmds";
				rockchip,cmd_type = <LPDT>;     
				rockchip,dsi_id = <0>;         
				rockchip,cmd = <0x15 0x87 0x02>;    
				rockchip,cmd_delay = <0>;
		};	
		rockchip,on-cmds126 { 
				compatible = "rockchip,on-cmds";
				rockchip,cmd_type = <LPDT>;     
				rockchip,dsi_id = <0>;         
				rockchip,cmd = <0x15 0x88 0x02>;    
				rockchip,cmd_delay = <0>;
		};	
		rockchip,on-cmds127 { 
				compatible = "rockchip,on-cmds";
				rockchip,cmd_type = <LPDT>;     
				rockchip,dsi_id = <0>;         
				rockchip,cmd = <0x15 0x89 0x02>;    
				rockchip,cmd_delay = <0>;
		};		
		rockchip,on-cmds128 { 
				compatible = "rockchip,on-cmds";
				rockchip,cmd_type = <LPDT>;     
				rockchip,dsi_id = <0>;         
				rockchip,cmd = <0x15 0x8a 0x02>;    
				rockchip,cmd_delay = <0>;
		};		
		rockchip,on-cmds129 { 
				compatible = "rockchip,on-cmds";
				rockchip,cmd_type = <LPDT>;     
				rockchip,dsi_id = <0>;         
				rockchip,cmd = <0x39 0xff 0x98 0x81 0x04>;    
				rockchip,cmd_delay = <0>;
		};	
		rockchip,on-cmds130 { 
				compatible = "rockchip,on-cmds";
				rockchip,cmd_type = <LPDT>;     
				rockchip,dsi_id = <0>;         
				rockchip,cmd = <0x15 0x6c 0x15>;    
				rockchip,cmd_delay = <0>;
		};
		rockchip,on-cmds131 { 
				compatible = "rockchip,on-cmds";
				rockchip,cmd_type = <LPDT>;     
				rockchip,dsi_id = <0>;         
				rockchip,cmd = <0x15 0x6e 0x2a>;    
				rockchip,cmd_delay = <0>;
		};	
		rockchip,on-cmds132 { 
				compatible = "rockchip,on-cmds";
				rockchip,cmd_type = <LPDT>;     
				rockchip,dsi_id = <0>;         
				rockchip,cmd = <0x15 0x6f 0x33>;    
				rockchip,cmd_delay = <0>;
		};		
		rockchip,on-cmds133 { 
				compatible = "rockchip,on-cmds";
				rockchip,cmd_type = <LPDT>;     
				rockchip,dsi_id = <0>;         
				rockchip,cmd = <0x15 0x3a 0x94>;    
				rockchip,cmd_delay = <0>;
		};		
		rockchip,on-cmds134 { 
				compatible = "rockchip,on-cmds";
				rockchip,cmd_type = <LPDT>;     
				rockchip,dsi_id = <0>;         
				rockchip,cmd = <0x15 0x8d 0x15>;    
				rockchip,cmd_delay = <0>;
		};		
		rockchip,on-cmds135 { 
				compatible = "rockchip,on-cmds";
				rockchip,cmd_type = <LPDT>;     
				rockchip,dsi_id = <0>;         
				rockchip,cmd = <0x15 0x87 0xba>;    
				rockchip,cmd_delay = <0>;
		};	
		rockchip,on-cmds136 { 
				compatible = "rockchip,on-cmds";
				rockchip,cmd_type = <LPDT>;     
				rockchip,dsi_id = <0>;         
				rockchip,cmd = <0x15 0x26 0x76>;    
				rockchip,cmd_delay = <0>;
		};	
		rockchip,on-cmds137 { 
				compatible = "rockchip,on-cmds";
				rockchip,cmd_type = <LPDT>;     
				rockchip,dsi_id = <0>;         
				rockchip,cmd = <0x15 0xb2 0xd1>;    
				rockchip,cmd_delay = <0>;
		};		
		rockchip,on-cmds138 { 
				compatible = "rockchip,on-cmds";
				rockchip,cmd_type = <LPDT>;     
				rockchip,dsi_id = <0>;         
				rockchip,cmd = <0x15 0xb5 0x06>;    
				rockchip,cmd_delay = <0>;
		};		
		rockchip,on-cmds139 { 
				compatible = "rockchip,on-cmds";
				rockchip,cmd_type = <LPDT>;     
				rockchip,dsi_id = <0>;         
				rockchip,cmd = <0x39 0xff 0x98 0x81 0x01>;    
				rockchip,cmd_delay = <0>;
		};	
		rockchip,on-cmds140 { 
				compatible = "rockchip,on-cmds";
				rockchip,cmd_type = <LPDT>;     
				rockchip,dsi_id = <0>;         
				rockchip,cmd = <0x15 0x22 0x0a>;    
				rockchip,cmd_delay = <0>;
		};
		rockchip,on-cmds141 { 
				compatible = "rockchip,on-cmds";
				rockchip,cmd_type = <LPDT>;     
				rockchip,dsi_id = <0>;         
				rockchip,cmd = <0x15 0x31 0x00>;    
				rockchip,cmd_delay = <0>;
		};	
		rockchip,on-cmds142 { 
				compatible = "rockchip,on-cmds";
				rockchip,cmd_type = <LPDT>;     
				rockchip,dsi_id = <0>;         
				rockchip,cmd = <0x15 0x53 0xa5>;    
				rockchip,cmd_delay = <0>;
		};		
		rockchip,on-cmds143 { 
				compatible = "rockchip,on-cmds";
				rockchip,cmd_type = <LPDT>;     
				rockchip,dsi_id = <0>;         
				rockchip,cmd = <0x15 0x55 0xa2>;    
				rockchip,cmd_delay = <0>;
		};		
		rockchip,on-cmds144 { 
				compatible = "rockchip,on-cmds";
				rockchip,cmd_type = <LPDT>;     
				rockchip,dsi_id = <0>;         
				rockchip,cmd = <0x15 0x50 0xb7>;    
				rockchip,cmd_delay = <0>;
		};		
		rockchip,on-cmds145 { 
				compatible = "rockchip,on-cmds";
				rockchip,cmd_type = <LPDT>;     
				rockchip,dsi_id = <0>;         
				rockchip,cmd = <0x15 0x51 0xb7>;    
				rockchip,cmd_delay = <0>;
		};	
		rockchip,on-cmds146 { 
				compatible = "rockchip,on-cmds";
				rockchip,cmd_type = <LPDT>;     
				rockchip,dsi_id = <0>;         
				rockchip,cmd = <0x15 0x60 0x22>;    
				rockchip,cmd_delay = <0>;
		};	
		rockchip,on-cmds147 { 
				compatible = "rockchip,on-cmds";
				rockchip,cmd_type = <LPDT>;     
				rockchip,dsi_id = <0>;         
				rockchip,cmd = <0x15 0x61 0x00>;    
				rockchip,cmd_delay = <0>;
		};		
		rockchip,on-cmds148 { 
				compatible = "rockchip,on-cmds";
				rockchip,cmd_type = <LPDT>;     
				rockchip,dsi_id = <0>;         
				rockchip,cmd = <0x15 0x62 0x19>;    
				rockchip,cmd_delay = <0>;
		};		
		rockchip,on-cmds149 { 
				compatible = "rockchip,on-cmds";
				rockchip,cmd_type = <LPDT>;     
				rockchip,dsi_id = <0>;         
				rockchip,cmd = <0x15 0x63 0x10>;    
				rockchip,cmd_delay = <0>;
		};	
		rockchip,on-cmds150 { 
				compatible = "rockchip,on-cmds";
				rockchip,cmd_type = <LPDT>;     
				rockchip,dsi_id = <0>;         
				rockchip,cmd = <0x15 0xa0 0x08>;    
				rockchip,cmd_delay = <0>;
		};
		rockchip,on-cmds151 { 
				compatible = "rockchip,on-cmds";
				rockchip,cmd_type = <LPDT>;     
				rockchip,dsi_id = <0>;         
				rockchip,cmd = <0x15 0xa1 0x17>;    
				rockchip,cmd_delay = <0>;
		};	
		rockchip,on-cmds152 { 
				compatible = "rockchip,on-cmds";
				rockchip,cmd_type = <LPDT>;     
				rockchip,dsi_id = <0>;         
				rockchip,cmd = <0x15 0xa2 0x1e>;    
				rockchip,cmd_delay = <0>;
		};		
		rockchip,on-cmds153 { 
				compatible = "rockchip,on-cmds";
				rockchip,cmd_type = <LPDT>;     
				rockchip,dsi_id = <0>;         
				rockchip,cmd = <0x15 0xa3 0x0e>;    
				rockchip,cmd_delay = <0>;
		};		
		rockchip,on-cmds154 { 
				compatible = "rockchip,on-cmds";
				rockchip,cmd_type = <LPDT>;     
				rockchip,dsi_id = <0>;         
				rockchip,cmd = <0x15 0xa4 0x13>;    
				rockchip,cmd_delay = <0>;
		};		
		rockchip,on-cmds155 { 
				compatible = "rockchip,on-cmds";
				rockchip,cmd_type = <LPDT>;     
				rockchip,dsi_id = <0>;         
				rockchip,cmd = <0x15 0xa5 0x24>;    
				rockchip,cmd_delay = <0>;
		};	
		rockchip,on-cmds156 { 
				compatible = "rockchip,on-cmds";
				rockchip,cmd_type = <LPDT>;     
				rockchip,dsi_id = <0>;         
				rockchip,cmd = <0x15 0xa6 0x1b>;    
				rockchip,cmd_delay = <0>;
		};	
		rockchip,on-cmds157 { 
				compatible = "rockchip,on-cmds";
				rockchip,cmd_type = <LPDT>;     
				rockchip,dsi_id = <0>;         
				rockchip,cmd = <0x15 0xa7 0x1b>;    
				rockchip,cmd_delay = <0>;
		};		
		rockchip,on-cmds158 { 
				compatible = "rockchip,on-cmds";
				rockchip,cmd_type = <LPDT>;     
				rockchip,dsi_id = <0>;         
				rockchip,cmd = <0x15 0xa8 0x53>;    
				rockchip,cmd_delay = <0>;
		};		
		rockchip,on-cmds159 { 
				compatible = "rockchip,on-cmds";
				rockchip,cmd_type = <LPDT>;     
				rockchip,dsi_id = <0>;         
				rockchip,cmd = <0x15 0xa9 0x1b>;    
				rockchip,cmd_delay = <0>;
		};	
		rockchip,on-cmds160 { 
				compatible = "rockchip,on-cmds";
				rockchip,cmd_type = <LPDT>;     
				rockchip,dsi_id = <0>;         
				rockchip,cmd = <0x15 0xaa 0x28>;    
				rockchip,cmd_delay = <0>;
		};
		rockchip,on-cmds161 { 
				compatible = "rockchip,on-cmds";
				rockchip,cmd_type = <LPDT>;     
				rockchip,dsi_id = <0>;         
				rockchip,cmd = <0x15 0xab 0x45>;    
				rockchip,cmd_delay = <0>;
		};	
		rockchip,on-cmds162 { 
				compatible = "rockchip,on-cmds";
				rockchip,cmd_type = <LPDT>;     
				rockchip,dsi_id = <0>;         
				rockchip,cmd = <0x15 0xac 0x1a>;    
				rockchip,cmd_delay = <0>;
		};		
		rockchip,on-cmds163 { 
				compatible = "rockchip,on-cmds";
				rockchip,cmd_type = <LPDT>;     
				rockchip,dsi_id = <0>;         
				rockchip,cmd = <0x15 0xad 0x1a>;    
				rockchip,cmd_delay = <0>;
		};		
		rockchip,on-cmds164 { 
				compatible = "rockchip,on-cmds";
				rockchip,cmd_type = <LPDT>;     
				rockchip,dsi_id = <0>;         
				rockchip,cmd = <0x15 0xae 0x50>;    
				rockchip,cmd_delay = <0>;
		};		
		rockchip,on-cmds165 { 
				compatible = "rockchip,on-cmds";
				rockchip,cmd_type = <LPDT>;     
				rockchip,dsi_id = <0>;         
				rockchip,cmd = <0x15 0xaf 0x21>;    
				rockchip,cmd_delay = <0>;
		};	
		rockchip,on-cmds166 { 
				compatible = "rockchip,on-cmds";
				rockchip,cmd_type = <LPDT>;     
				rockchip,dsi_id = <0>;         
				rockchip,cmd = <0x15 0xb0 0x2c>;    
				rockchip,cmd_delay = <0>;
		};	
		rockchip,on-cmds167 { 
				compatible = "rockchip,on-cmds";
				rockchip,cmd_type = <LPDT>;     
				rockchip,dsi_id = <0>;         
				rockchip,cmd = <0x15 0xb1 0x3b>;    
				rockchip,cmd_delay = <0>;
		};		
		rockchip,on-cmds168 { 
				compatible = "rockchip,on-cmds";
				rockchip,cmd_type = <LPDT>;     
				rockchip,dsi_id = <0>;         
				rockchip,cmd = <0x15 0xb2 0x63>;    
				rockchip,cmd_delay = <0>;
		};		
		rockchip,on-cmds169 { 
				compatible = "rockchip,on-cmds";
				rockchip,cmd_type = <LPDT>;     
				rockchip,dsi_id = <0>;         
				rockchip,cmd = <0x15 0xb3 0x39>;    
				rockchip,cmd_delay = <0>;
		};	
		rockchip,on-cmds170 { 
				compatible = "rockchip,on-cmds";
				rockchip,cmd_type = <LPDT>;     
				rockchip,dsi_id = <0>;         
				rockchip,cmd = <0x15 0xc0 0x08>;    
				rockchip,cmd_delay = <0>;
		};
		rockchip,on-cmds171 { 
				compatible = "rockchip,on-cmds";
				rockchip,cmd_type = <LPDT>;     
				rockchip,dsi_id = <0>;         
				rockchip,cmd = <0x15 0xc1 0x0c>;    
				rockchip,cmd_delay = <0>;
		};	
		rockchip,on-cmds172 { 
				compatible = "rockchip,on-cmds";
				rockchip,cmd_type = <LPDT>;     
				rockchip,dsi_id = <0>;         
				rockchip,cmd = <0x15 0xc2 0x17>;    
				rockchip,cmd_delay = <0>;
		};		
		rockchip,on-cmds173 { 
				compatible = "rockchip,on-cmds";
				rockchip,cmd_type = <LPDT>;     
				rockchip,dsi_id = <0>;         
				rockchip,cmd = <0x15 0xc3 0x0f>;    
				rockchip,cmd_delay = <0>;
		};		
		rockchip,on-cmds174 { 
				compatible = "rockchip,on-cmds";
				rockchip,cmd_type = <LPDT>;     
				rockchip,dsi_id = <0>;         
				rockchip,cmd = <0x15 0xc4 0x0b>;    
				rockchip,cmd_delay = <0>;
		};		
		rockchip,on-cmds175 { 
				compatible = "rockchip,on-cmds";
				rockchip,cmd_type = <LPDT>;     
				rockchip,dsi_id = <0>;         
				rockchip,cmd = <0x15 0xc5 0x1c>;    
				rockchip,cmd_delay = <0>;
		};	
		rockchip,on-cmds176 { 
				compatible = "rockchip,on-cmds";
				rockchip,cmd_type = <LPDT>;     
				rockchip,dsi_id = <0>;         
				rockchip,cmd = <0x15 0xc6 0x10>;    
				rockchip,cmd_delay = <0>;
		};	
		rockchip,on-cmds177 { 
				compatible = "rockchip,on-cmds";
				rockchip,cmd_type = <LPDT>;     
				rockchip,dsi_id = <0>;         
				rockchip,cmd = <0x15 0xc7 0x16>;    
				rockchip,cmd_delay = <0>;
		};		
		rockchip,on-cmds178 { 
				compatible = "rockchip,on-cmds";
				rockchip,cmd_type = <LPDT>;     
				rockchip,dsi_id = <0>;         
				rockchip,cmd = <0x15 0xc8 0x5b>;    
				rockchip,cmd_delay = <0>;
		};		
		rockchip,on-cmds179 { 
				compatible = "rockchip,on-cmds";
				rockchip,cmd_type = <LPDT>;     
				rockchip,dsi_id = <0>;         
				rockchip,cmd = <0x15 0xc9 0x1a>;    
				rockchip,cmd_delay = <0>;
		};	
		rockchip,on-cmds180 { 
				compatible = "rockchip,on-cmds";
				rockchip,cmd_type = <LPDT>;     
				rockchip,dsi_id = <0>;         
				rockchip,cmd = <0x15 0xca 0x26>;    
				rockchip,cmd_delay = <0>;
		};
		rockchip,on-cmds181 { 
				compatible = "rockchip,on-cmds";
				rockchip,cmd_type = <LPDT>;     
				rockchip,dsi_id = <0>;         
				rockchip,cmd = <0x15 0xcb 0x55>;    
				rockchip,cmd_delay = <0>;
		};	
		rockchip,on-cmds182 { 
				compatible = "rockchip,on-cmds";
				rockchip,cmd_type = <LPDT>;     
				rockchip,dsi_id = <0>;         
				rockchip,cmd = <0x15 0xcc 0x1d>;    
				rockchip,cmd_delay = <0>;
		};		
		rockchip,on-cmds183 { 
				compatible = "rockchip,on-cmds";
				rockchip,cmd_type = <LPDT>;     
				rockchip,dsi_id = <0>;         
				rockchip,cmd = <0x15 0xcd 0x1e>;    
				rockchip,cmd_delay = <0>;
		};		
		rockchip,on-cmds184 { 
				compatible = "rockchip,on-cmds";
				rockchip,cmd_type = <LPDT>;     
				rockchip,dsi_id = <0>;         
				rockchip,cmd = <0x15 0xce 0x52>;    
				rockchip,cmd_delay = <0>;
		};		
		rockchip,on-cmds185 { 
				compatible = "rockchip,on-cmds";
				rockchip,cmd_type = <LPDT>;     
				rockchip,dsi_id = <0>;         
				rockchip,cmd = <0x15 0xcf 0x26>;    
				rockchip,cmd_delay = <0>;
		};	
		rockchip,on-cmds186 { 
				compatible = "rockchip,on-cmds";
				rockchip,cmd_type = <LPDT>;     
				rockchip,dsi_id = <0>;         
				rockchip,cmd = <0x15 0xd0 0x29>;    
				rockchip,cmd_delay = <0>;
		};	
		rockchip,on-cmds187 { 
				compatible = "rockchip,on-cmds";
				rockchip,cmd_type = <LPDT>;     
				rockchip,dsi_id = <0>;         
				rockchip,cmd = <0x15 0xd1 0x45>;    
				rockchip,cmd_delay = <0>;
		};		
		rockchip,on-cmds188 { 
				compatible = "rockchip,on-cmds";
				rockchip,cmd_type = <LPDT>;     
				rockchip,dsi_id = <0>;         
				rockchip,cmd = <0x15 0xd2 0x63>;    
				rockchip,cmd_delay = <0>;
		};		
		rockchip,on-cmds189 { 
				compatible = "rockchip,on-cmds";
				rockchip,cmd_type = <LPDT>;     
				rockchip,dsi_id = <0>;         
				rockchip,cmd = <0x15 0xd3 0x39>;    
				rockchip,cmd_delay = <0>;
		};	
		rockchip,on-cmds190 { 
				compatible = "rockchip,on-cmds";
				rockchip,cmd_type = <LPDT>;     
				rockchip,dsi_id = <0>;         
				rockchip,cmd = <0x39 0xff 0x98 0x81 0x00>;    
				rockchip,cmd_delay = <0>;
		};
		rockchip,on-cmds191 { 
				compatible = "rockchip,on-cmds";
				rockchip,cmd_type = <LPDT>;     
				rockchip,dsi_id = <0>;         
				rockchip,cmd = <0x05 0x35>;    
				rockchip,cmd_delay = <0>;
		};	
		rockchip,on-cmds192 { 
				compatible = "rockchip,on-cmds";
				rockchip,cmd_type = <LPDT>;     
				rockchip,dsi_id = <0>;         
				rockchip,cmd = <0x15 0x3a 0x70>;    
				rockchip,cmd_delay = <0>;
		};		
		rockchip,on-cmds193 { 
				compatible = "rockchip,on-cmds";
				rockchip,cmd_type = <LPDT>;     
				rockchip,dsi_id = <0>;         
				rockchip,cmd = <0x05 0x11>;    
				rockchip,cmd_delay = <120>;
		};		
		rockchip,on-cmds194 { 
				compatible = "rockchip,on-cmds";
				rockchip,cmd_type = <LPDT>;     
				rockchip,dsi_id = <0>;         
				rockchip,cmd = <0x05 0x29>;    
				rockchip,cmd_delay = <120>;
		};		
	};

	*/
};
	


